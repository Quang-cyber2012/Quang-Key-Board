## boards/shields/quang_board/Kconfig.defconfig
```kconfig
config SHIELD_QUANG_BOARD
    def_bool y
if SHIELD_QUANG_BOARD

config ZMK_KEYBOARD_NAME
    default "quang_board"

endif # SHIELD_QUANG_BOARD
```
