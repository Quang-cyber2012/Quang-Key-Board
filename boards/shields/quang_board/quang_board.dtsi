/ {
    chosen {
        zmk,kscan = &kscan0;
    };

    kscan0: kscan {
        compatible = "zmk,kscan-gpio-matrix";

 row-gpios =
    <&gpio0 2 GPIO_ACTIVE_HIGH>,
    <&gpio0 3 GPIO_ACTIVE_HIGH>,
    <&gpio0 4 GPIO_ACTIVE_HIGH>,
    <&gpio0 5 GPIO_ACTIVE_HIGH>,
    <&gpio0 6 GPIO_ACTIVE_HIGH>;

col-gpios =
    <&gpio0 8 GPIO_ACTIVE_HIGH>,
    <&gpio0 9 GPIO_ACTIVE_HIGH>,
    <&gpio0 10 GPIO_ACTIVE_HIGH>,
    <&gpio0 11 GPIO_ACTIVE_HIGH>,
    <&gpio0 12 GPIO_ACTIVE_HIGH>,
    <&gpio0 13 GPIO_ACTIVE_HIGH>,
    <&gpio0 14 GPIO_ACTIVE_HIGH>,
    <&gpio0 15 GPIO_ACTIVE_HIGH>,
    <&gpio0 16 GPIO_ACTIVE_HIGH>,
    <&gpio0 17 GPIO_ACTIVE_HIGH>,
    <&gpio0 18 GPIO_ACTIVE_HIGH>,
    <&gpio0 19 GPIO_ACTIVE_HIGH>,
    <&gpio0 20 GPIO_ACTIVE_HIGH>;
    };
};
